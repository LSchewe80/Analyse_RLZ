/*@!Encoding:1252*/
/*
  Ersteller: Lars Schewe
  Datum: 28.02.2022
  
  aktualisiert: 10.03.2022

*/
includes
{
  
}

variables
{
  //Hilfsvariablen Timer
  float relTime_start;
  float relTime;
  
  //Signalvariable für E3V_EVCANFD::BMS_22
  float bmsLadeZustand;
  float bmsMaxLadeStrom;
  float bmsMaxLadeleistung;
  float bmsSpannung;
  float bmsStrom;
  
  //Signalvariable für E3V_EVCANFD::BMS_25
  float bmsTemperatur;
  
  //Signalvariable für MSG E3V_ACANFD::Motor_52
  float ladeZustand02;
  
  //Signalvariable für E3V_EVCANFD::HVLM_13
  float lvb_restladezeit;
  
  //Signalvariable für E3V_EVCANFD::HVLM_14
  float ladeSzenario;
  
  //interne Signale
  double cms_s_ICpMaxStromA;
  double ctm_s_iHVBatVektor_0;
  double ctm_s_iHVBatVektor_1;
  double ctm_s_iHVBatVektor_2;
  double ctm_s_iHVBatVektor_3;
  double ctm_s_iHVBatVektor_4;
  double ctm_s_iHVBatVektor_5;
  double ctm_s_iHVBatVektor_6;
  double ctm_s_iHVBatVektor_7;
  double ctm_s_iHVBatVektor_8;
  double ctm_s_iHVBatVektor_9;
  double ctm_s_iHVBatVektor_10;
  
  double ctm_s_valLadezeit1;
  double ctm_s_valLadezeit2;
  double ctm_s_valLadezeit3;
  double ctm_s_valLadezeit4;
  double ctm_s_valLadezeit5;
  double ctm_s_valLadezeit6;
  double ctm_s_valLadezeit7;
  double ctm_s_valLadezeit8;
  double ctm_s_valLadezeit9;
  double ctm_s_valLadezeit10;
  
  //Hilfsvariable
  int sigCounter = 1;
  int sigCounter_1 = 1;
  int sigCounter_2 = 1;
}

//-----------------------------------------------------------------------------------------------
Signalabfrage(){
    //Relative Messungszeit [s]
    relTime = timeNowInt64()/1000000000.0;
  
    bmsLadeZustand = getSignal(E3V_EVCANFD::BMS_22::BMS_Ladezustand);
    ladeZustand02 = getSignal(E3V_ACANFD::Motor_52::Ladezustand_02);
    bmsMaxLadeStrom = getSignal(E3V_EVCANFD::BMS_21::BMS_Max_Ladestrom);
    bmsMaxLadeleistung = getSignal(E3V_EVCANFD::BMS_21::BMS_Max_Ladeleistung);
    bmsSpannung = getSignal(E3V_EVCANFD::BMS_20::BMS_Spannung);
    bmsStrom = getSignal(E3V_EVCANFD::BMS_20::BMS_Strom);
    
    cms_s_ICpMaxStromA = sysGetVariableFloat(sysvar::CCP::A2l_Merge_A286::CMS_s_ICpMaxStromA);
    
    bmsTemperatur = getSignal(E3V_EVCANFD::BMS_25::BMS_Temperatur);
    
    lvb_restladezeit = getSignal(E3V_EVCANFD::HVLM_13::LVB_Restladezeit);
    
    ladeSzenario = getSignal(E3V_EVCANFD::HVLM_14::HVLM_Ladeszenario);
}

Signalausgabe(){
    write("Relative Messungszeit [s] : ;%.3f; sec",relTime);
    write("BMS Ladezustand = ;%.1f; %%",bmsLadeZustand);
    write("Ladezustand_02 : ;%.2f; %%",ladeZustand02);
    write("BMS_MaxLadestrom :;%.2f; Ampere ",bmsMaxLadeStrom);
    write("BMS_MaxLadeleistung :;%f; Watt",bmsMaxLadeleistung);
    write("BMS_Spannung : ;%.3f; Volt",bmsSpannung);
    write("BMS_Strom : ;%.3f; Ampere",bmsStrom);
    
    write("CMS_s_ICpMaxStromA: ;%.1f; Ampere",cms_s_ICpMaxStromA);
    
    
    write("BMS_Temperatur: ;%.1f; °C",bmsTemperatur);
    
    write("LVB_Restladdezeit: [m] ;%.1f; min",lvb_restladezeit);
}

//-----------------------------------------------------------------------------------------------
on start
{
  //Relative Messungszeit [s]
  //relTime_start = timeNowInt64()/1000000000.0;
  
  msgBeep(5);
  
  //Signalabfrage();
  
  //write("/************Werte bei Messstart*****************/");
  Signalausgabe();
  //write("/************************************************/");
}

//-----------------------------------------------------------------------------------------------
on message E3V_EVCANFD::BMS_22
{ 
  Signalabfrage();
  
  //Auswertung bei BMS_Ladezustand == 20%
  if(bmsLadeZustand >= 20 && bmsLadeZustand <= 21 && sigCounter == 1)
  {
    write("/******************* i = 2 ***********************/");
    write("/************BMS Ladezustand = 20 %%**************/");
    write("Bezeichnung ;C; 20 %%");
    Signalausgabe();
    write("/************************************************/");
    sigCounter++;
  }
  
  //Auswertung bei BMS_Ladezustand == 30%
  if(bmsLadeZustand >= 30 && bmsLadeZustand <= 31 && sigCounter == 2)
  {
    write("/******************* i = 3 ***********************/");
    write("/************BMS Ladezustand = 30 %%**************/");
    write("Bezeichnung ;D; 30 %%");
    Signalausgabe();
    write("/************************************************/");
    sigCounter++;
  }
  
  //Auswertung bei BMS_Ladezustand == 40%
  if(bmsLadeZustand >= 40 && bmsLadeZustand <= 41 && sigCounter == 3)
  {
    write("/******************* i = 4 ***********************/");
    write("/************BMS Ladezustand = 40 %%**************/");
    Signalausgabe();
    write("/************************************************/");
    sigCounter++;
  }
  
  //Auswertung bei BMS_Ladezustand == 50%
  if(bmsLadeZustand >= 50 && bmsLadeZustand <= 51 && sigCounter == 4)
  {
    write("/******************* i = 5 ***********************/");
    write("/************BMS Ladezustand = 50 %%**************/");
    Signalausgabe();
    write("/************************************************/");
    sigCounter++;
  }
  
  //Auswertung bei BMS_Ladezustand == 60%
  if(bmsLadeZustand >= 60 && bmsLadeZustand <= 61 && sigCounter == 5)
  {
    write("/******************* i = 6 ***********************/");
    write("/************BMS Ladezustand = 60 %%**************/");
    write("Bezeichnung ;G; 60 %%");
    Signalausgabe();
    write("/************************************************/");
    sigCounter++;
  }

  //Auswertung bei BMS_Ladezustand == 70%
  if(bmsLadeZustand >= 70 && bmsLadeZustand <= 71 && sigCounter == 6)
  {
    write("/******************* i = 7 ***********************/");
    write("/************BMS Ladezustand = 70 %%**************/");
    write("Bezeichnung ;H; 70 %%");
    Signalausgabe();
    write("/************************************************/");
    sigCounter++;
  }

  //Auswertung bei BMS_Ladezustand == 80%
  if(bmsLadeZustand >= 80 && bmsLadeZustand <= 81 && sigCounter == 7)
  {
    write("/******************* i = 8 ***********************/");
    write("/************BMS Ladezustand = 80 %%**************/");
    write("Bezeichnung ;I; 80 %%");
    Signalausgabe();
    write("/************************************************/");
    sigCounter++;
  }

  //Auswertung bei BMS_Ladezustand == 90%
  if(bmsLadeZustand >= 90 && bmsLadeZustand <= 91 && sigCounter == 8)
  {
    write("/******************* i = 9 ***********************/");
    write("/************BMS Ladezustand = 90 %%**************/");
    write("Bezeichnung ;J; 90 %%");
    Signalausgabe();
    write("/************************************************/");
    sigCounter++;
  }
  
  
  output(this);
}

//-----------------------------------------------------------------------------------------------
on message E3V_ACANFD::Motor_52
{ 
  Signalabfrage();

  //Auswertung Ladezustand_02 == 10%
  if(ladeZustand02 >= 10 && ladeZustand02 <= 11 && sigCounter_1 == 1)
  {
    write("/******************* i = 1 ***********************/");
    write("/************Ladezustand_02  = 10 %%**************/");
    write("Bezeichnung ;B; 10 %%");
    Signalausgabe();
    write("/************************************************/");
    sigCounter_1++;
  }

  //Auswertung Ladezustand_02 == 100%
  if(ladeZustand02 >= 100 &&  ladeSzenario != 5 && sigCounter_1 == 2)
  {
    write("/******************* i = 10 **********************/");
    write("/************BMS Ladezustand = 100 %%*************/");
    write("Bezeichnung ;K; 100 %%");
    Signalausgabe();
    write("/************************************************/");
    write("Analyse beendet --> Wichtig: Datei unter RLZ.csv speichern!");
    sigCounter_1++;
  }
  
  output(this);
}

//-----------------------------------------------------------------------------------------------
on message E3V_EVCANFD::HVLM_14
{
  //Signalauslesung für die Ermittlung --> Startpunkt: Direkt vor Ladebeginn
  if(ladeSzenario != 5 && sigCounter_2 == 1)
  { 
      Signalabfrage();
  }
  
  //Auswertung Wechsel HVLM_Ladeszenario in Sofortlade_aktiv
  if(ladeSzenario == 5 && bmsLadeZustand <= 20 && sigCounter_2 == 1)  //ladeSzenario == Sofortladen_aktiv (5)
  {
    write("/******************* i = 0 ***********************/");
    write("/******HVLM_Ladeszenario = Sofortladen_aktiv*******/");
    write("Bezeichnung ;A; 0 %%");
    Signalausgabe();
    write("/************************************************/");
    sigCounter_2++;
  }
  
  output(this);
}


on message *
{
  output(this);
}