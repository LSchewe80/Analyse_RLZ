/*@!Encoding:1252*/
includes
{
  
}

variables
{
  float relTime_start;
  float relTime;
  float relTime_1;
  float relTime_2;
  
  //Signalvariable für MSG BMS_22
  float bmsLadeZustand;
  float bmsMaxLadeStrom;
  float bmsMaxLadeleistung;
  float bmsSpannung;
  float bmsStrom;
  
  //Signalvariable für MSG E3V_ACANFD::Motor_52
  float ladeZustand02;
  
  //Signalvariable für MSG HVLM
  float ladeSzenario;
  
  
  //Hilfsvariable
  int sigCounter = 1;
  int sigCounter_1 = 1;
  int sigCounter_2 = 1;
}

on start
{
  //Relative Messungszeit [s]
  relTime_start = timeNowInt64()/1000000000.0;
  
  msgBeep(5);
  
  //Signalauslesung
  bmsLadeZustand = getSignal(E3V_EVCANFD::BMS_22::BMS_Ladezustand);
  ladeZustand02 = getSignal(E3V_ACANFD::Motor_52::Ladezustand_02);
  bmsMaxLadeStrom = getSignal(E3V_EVCANFD::BMS_21::BMS_Max_Ladestrom);
  bmsMaxLadeleistung = getSignal(E3V_EVCANFD::BMS_21::BMS_Max_Ladeleistung);
  bmsSpannung = getSignal(E3V_EVCANFD::BMS_20::BMS_Spannung);
  bmsStrom = getSignal(E3V_EVCANFD::BMS_20::BMS_Strom);
  ladeSzenario = getSignal(E3V_EVCANFD::HVLM_14::HVLM_Ladeszenario);
  
  
  write("/************Werte bei Messstart*****************/");
  write("Relative Messungszeit [s] :  ; %.3f ; sec",relTime_start);
  write("BMS_Ladezustand :  ; %.1f ; %%",bmsLadeZustand);
  write("Ladezustand_02 :  ; %.1f ; %%",ladeZustand02);
  write("BMS_MaxLadestrom :  ; %.1f ; Ampere ",bmsMaxLadeStrom);
  write("BMS_MaxLadeleistung :  ; %.1f ; Watt",bmsMaxLadeleistung);
  write("BMS_Spannung :  ; %.3f ; Volt",bmsSpannung);
  write("BMS_Strom :  ; %.3f ; Ampere",bmsStrom);
  write("/************************************************/");
}

on message E3V_EVCANFD::BMS_22
{ 
  //Relative Messungszeit [s]
  relTime = timeNowInt64()/1000000000.0;
  
  //Signalauslesung
  bmsLadeZustand = getSignal(E3V_EVCANFD::BMS_22::BMS_Ladezustand);
  ladeZustand02 = getSignal(E3V_ACANFD::Motor_52::Ladezustand_02);
  bmsMaxLadeStrom = getSignal(E3V_EVCANFD::BMS_21::BMS_Max_Ladestrom);
  bmsMaxLadeleistung = getSignal(E3V_EVCANFD::BMS_21::BMS_Max_Ladeleistung);
  bmsSpannung = getSignal(E3V_EVCANFD::BMS_20::BMS_Spannung);
  bmsStrom = getSignal(E3V_EVCANFD::BMS_20::BMS_Strom);
  ladeSzenario = getSignal(E3V_EVCANFD::HVLM_14::HVLM_Ladeszenario);
  
  
  //Auswertung bei BMS_Ladezustand == 20%
  if(bmsLadeZustand >= 20 && bmsLadeZustand <= 21 && sigCounter == 1)
  {
    write("/******************* i = 2 ***********************/");
    write("/************BMS Ladezustand = 20 %%**************/");
    write("Relative Messungszeit [s] :  ; %.3f ; sec",relTime);
    write("BMS Ladezustand =  ; 20 ; %%");
    write("Ladezustand_02 :  ; %.1f ; %%",ladeZustand02);
    write("BMS_MaxLadestrom :  ; %.1f ; Ampere ",bmsMaxLadeStrom);
    write("BMS_MaxLadeleistung :  ; %.1f ; Watt",bmsMaxLadeleistung);
    write("BMS_Spannung :  ; %.3f ; Volt",bmsSpannung);
    write("BMS_Strom :  ; %.3f ; Ampere",bmsStrom);
    write("/************************************************/");
    sigCounter++;
  }
  
  //Auswertung bei BMS_Ladezustand == 30%
  if(bmsLadeZustand >= 30 && bmsLadeZustand <= 31 && sigCounter == 2)
  {
    write("/******************* i = 3 ***********************/");
    write("/************BMS Ladezustand = 30 %%**************/");
    write("Relative Messungszeit [s] :  ; %.3f ; sec",relTime);
    write("BMS Ladezustand =  ; 30 ; %%");
    write("Ladezustand_02 :  ; %.1f ; %%",ladeZustand02);
    write("BMS_MaxLadestrom :  ; %.1f ; Ampere ",bmsMaxLadeStrom);
    write("BMS_MaxLadeleistung :  ; %.1f ; Watt",bmsMaxLadeleistung);
    write("BMS_Spannung :  ; %.3f ; Volt",bmsSpannung);
    write("BMS_Strom :  ; %.3f ; Ampere",bmsStrom);
    write("/************************************************/");
    sigCounter++;
  }
  
  //Auswertung bei BMS_Ladezustand == 40%
  if(bmsLadeZustand >= 40 && bmsLadeZustand <= 41 && sigCounter == 3)
  {
    write("/******************* i = 4 ***********************/");
    write("/************BMS Ladezustand = 40 %%**************/");
    write("Relative Messungszeit [s] :  ; %.3f ; sec",relTime);
    write("BMS Ladezustand =  ; 40 ; %%");
    write("Ladezustand_02 :  ; %.1f ; %%",ladeZustand02);
    write("BMS_MaxLadestrom :  ; %.1f ; Ampere ",bmsMaxLadeStrom);
    write("BMS_MaxLadeleistung :  ; %.1f ; Watt",bmsMaxLadeleistung);
    write("BMS_Spannung :  ; %.3f ; Volt",bmsSpannung);
    write("BMS_Strom :  ; %.3f ; Ampere",bmsStrom);
    write("/************************************************/");
    sigCounter++;
  }
  
  //Auswertung bei BMS_Ladezustand == 50%
  if(bmsLadeZustand >= 50 && bmsLadeZustand <= 51 && sigCounter == 4)
  {
    write("/******************* i = 5 ***********************/");
    write("/************BMS Ladezustand = 50 %%**************/");
    write("Relative Messungszeit [s] :  ; %.3f ; sec",relTime);
    write("BMS Ladezustand =  ; 50 ; %%");
    write("Ladezustand_02 :  ; %.1f ; %%",ladeZustand02);
    write("BMS_MaxLadestrom :  ; %.1f ; Ampere ",bmsMaxLadeStrom);
    write("BMS_MaxLadeleistung :  ; %.1f ; Watt",bmsMaxLadeleistung);
    write("BMS_Spannung :  ; %.3f ; Volt",bmsSpannung);
    write("BMS_Strom :  ; %.3f ; Ampere",bmsStrom);
    write("/************************************************/");
    sigCounter++;
  }
  
  //Auswertung bei BMS_Ladezustand == 60%
  if(bmsLadeZustand >= 60 && bmsLadeZustand <= 61 && sigCounter == 5)
  {
    write("/******************* i = 6 ***********************/");
    write("/************BMS Ladezustand = 60 %%**************/");
    write("Relative Messungszeit [s] :  ; %.3f ; sec",relTime);
    write("BMS Ladezustand =  ; 60 ; %%");
    write("Ladezustand_02 :  ; %.1f ; %%",ladeZustand02);
    write("BMS_MaxLadestrom :  ; %.1f ; Ampere ",bmsMaxLadeStrom);
    write("BMS_MaxLadeleistung :  ; %.1f ; Watt",bmsMaxLadeleistung);
    write("BMS_Spannung :  ; %.3f ; Volt",bmsSpannung);
    write("BMS_Strom :  ; %.3f ; Ampere",bmsStrom);
    write("/************************************************/");
    sigCounter++;
  }

  //Auswertung bei BMS_Ladezustand == 70%
  if(bmsLadeZustand >= 70 && bmsLadeZustand <= 71 && sigCounter == 6)
  {
    write("/******************* i = 7 ***********************/");
    write("/************BMS Ladezustand = 70 %%**************/");
    write("Relative Messungszeit [s] :  ; %.3f ; sec",relTime);
    write("BMS Ladezustand =  ; 70 ; %%");
    write("Ladezustand_02 :  ; %.1f ; %%",ladeZustand02);
    write("BMS_MaxLadestrom :  ; %.1f ; Ampere ",bmsMaxLadeStrom);
    write("BMS_MaxLadeleistung :  ; %.1f ; Watt",bmsMaxLadeleistung);
    write("BMS_Spannung :  ; %.3f ; Volt",bmsSpannung);
    write("BMS_Strom :  ; %.3f ; Ampere",bmsStrom);
    write("/************************************************/");
    sigCounter++;
  }

  //Auswertung bei BMS_Ladezustand == 80%
  if(bmsLadeZustand >= 80 && bmsLadeZustand <= 81 && sigCounter == 7)
  {
    write("/******************* i = 8 ***********************/");
    write("/************BMS Ladezustand = 80 %%**************/");
    write("Relative Messungszeit [s] :  ; %.3f ; sec",relTime);
    write("BMS Ladezustand =  ; 80 ; %%");
    write("Ladezustand_02 :  ; %.1f ; %%",ladeZustand02);
    write("BMS_MaxLadestrom :  ; %.1f ; Ampere ",bmsMaxLadeStrom);
    write("BMS_MaxLadeleistung :  ; %.1f ; Watt",bmsMaxLadeleistung);
    write("BMS_Spannung :  ; %.3f ; Volt",bmsSpannung);
    write("BMS_Strom :  ; %.3f ; Ampere",bmsStrom);
    write("/************************************************/");
    sigCounter++;
  }

  //Auswertung bei BMS_Ladezustand == 90%
  if(bmsLadeZustand >= 90 && bmsLadeZustand <= 91 && sigCounter == 8)
  {
    write("/******************* i = 9 ***********************/");
    write("/************BMS Ladezustand = 90 %%**************/");
    write("Relative Messungszeit [s] :  ; %.3f ; sec",relTime);
    write("BMS Ladezustand =  ; 90 ; %%");
    write("Ladezustand_02 :  ; %.1f ; %%",ladeZustand02);
    write("BMS_MaxLadestrom :  ; %.1f ; Ampere ",bmsMaxLadeStrom);
    write("BMS_MaxLadeleistung :  ; %.1f , Watt",bmsMaxLadeleistung);
    write("BMS_Spannung :  ; %.3f ; Volt",bmsSpannung);
    write("BMS_Strom :  ; %.3f ; Ampere",bmsStrom);
    write("/************************************************/");
    sigCounter++;
  }
  
  
  output(this);
}

on message E3V_ACANFD::Motor_52
{ 
  //Relative Messungszeit [s]
  relTime_1 = timeNowInt64()/1000000000.0;

  //Signalauslesung
  bmsLadeZustand = getSignal(E3V_EVCANFD::BMS_22::BMS_Ladezustand);
  ladeZustand02 = getSignal(E3V_ACANFD::Motor_52::Ladezustand_02);
  bmsMaxLadeStrom = getSignal(E3V_EVCANFD::BMS_21::BMS_Max_Ladestrom);
  bmsMaxLadeleistung = getSignal(E3V_EVCANFD::BMS_21::BMS_Max_Ladeleistung);
  bmsSpannung = getSignal(E3V_EVCANFD::BMS_20::BMS_Spannung);
  bmsStrom = getSignal(E3V_EVCANFD::BMS_20::BMS_Strom);
  ladeSzenario = getSignal(E3V_EVCANFD::HVLM_14::HVLM_Ladeszenario);


  //Auswertung Ladezustand_02 == 10%
  if(ladeZustand02 >= 10 && ladeZustand02 <= 11 && sigCounter_1 == 1)
  {
    write("/******************* i = 1 ***********************/");
    write("/************Ladezustand_02  = 10 %%**************/");
    write("Relative Messungszeit [s] :  ; %.3f ; sec",relTime);
    write("BMS_Ladezustand :  ; %.1f ; %%",bmsLadeZustand);
    write("Ladezustand_02 :  ; %.1f ; %%",ladeZustand02);
    write("BMS_MaxLadestrom :  ; %.1f ; Ampere ",bmsMaxLadeStrom);
    write("BMS_MaxLadeleistung :  ; %.1f ; Watt",bmsMaxLadeleistung);
    write("BMS_Spannung :  ; %.3f ; Volt",bmsSpannung);
    write("BMS_Strom :  ; %.3f ; Ampere",bmsStrom);
    write("/************************************************/");
    sigCounter_1++;
  }

  //Auswertung Ladezustand_02 == 100%
  if(ladeZustand02 >= 100 &&  ladeSzenario != 5 && sigCounter_1 == 2)
  {
    write("/******************* i = 10 **********************/");
    write("/************BMS Ladezustand = 100 %%*************/");
    write("Relative Messungszeit [s] :  ; %.3f ; sec",relTime);
    write("BMS_Ladezustand :  ; %.1f ; %%",bmsLadeZustand);
    write("Ladezustand_02 :  ; %.1f ; %%",ladeZustand02);
    write("BMS_MaxLadestrom :  ; %.1f ; Ampere ",bmsMaxLadeStrom);
    write("BMS_MaxLadeleistung :  ; %.1f ; Watt",bmsMaxLadeleistung);
    write("BMS_Spannung :  ; %.3f ; Volt",bmsSpannung);
    write("BMS_Strom :  ; %.3f ; Ampere",bmsStrom);
    write("/************************************************/");
    sigCounter_1++;
  }
  
  output(this);
}

on message E3V_EVCANFD::HVLM_14
{
  //Relative Messungszeit [s]
  relTime_2 = timeNowInt64()/1000000000.0;

  //Signalauslesung für die Ermittlung --> Startpunkt: Direkt vor Ladebeginn
  if(ladeSzenario != 5 && sigCounter_2 == 1)
  {
    bmsLadeZustand = getSignal(E3V_EVCANFD::BMS_22::BMS_Ladezustand);
    ladeZustand02 = getSignal(E3V_ACANFD::Motor_52::Ladezustand_02);
    bmsMaxLadeStrom = getSignal(E3V_EVCANFD::BMS_21::BMS_Max_Ladestrom);
    bmsMaxLadeleistung = getSignal(E3V_EVCANFD::BMS_21::BMS_Max_Ladeleistung);
    bmsSpannung = getSignal(E3V_EVCANFD::BMS_20::BMS_Spannung);
    bmsStrom = getSignal(E3V_EVCANFD::BMS_20::BMS_Strom);
    ladeSzenario = getSignal(E3V_EVCANFD::HVLM_14::HVLM_Ladeszenario);
  }
  
  //Auswertung Wechsel HVLM_Ladeszenario in Sofortlade_aktiv
  if(ladeSzenario == 5 && bmsLadeZustand <= 20 && sigCounter_2 == 1)  //ladeSzenario == Sofortladen_aktiv (5)
  {
    write("/******************* i = 0 ***********************/");
    write("/******HVLM_Ladeszenario = Sofortlade_aktiv*******/");
    write("Relative Messungszeit [s] :  ; %.3f ; sec",relTime);
    write("BMS_Ladezustand :  ; %.1f ; %%",bmsLadeZustand);
    write("Ladezustand_02 :  ; %.1f ; %%",ladeZustand02);
    write("BMS_MaxLadestrom :  ; %.1f ; Ampere ",bmsMaxLadeStrom);
    write("BMS_MaxLadeleistung :  ; %.1f ; Watt",bmsMaxLadeleistung);
    write("BMS_Spannung :  ; %.3f ; Volt",bmsSpannung);
    write("BMS_Strom :  ; %.3f ; Ampere",bmsStrom);
    write("/************************************************/");
    sigCounter_2++;
  }
  
  output(this);
}


on message *
{
  output(this);
}